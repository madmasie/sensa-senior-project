/*
 * calibrate.cpp — On-device PM2.5 calibration using TensorFlow Lite Micro.
 *
 * See include/ml/calibrate.h for the high-level explanation of what this
 * module is for. This file contains the TFLite Micro plumbing.
 *
 * THIS FILE HAS TWO HALVES, SELECTED AUTOMATICALLY AT COMPILE TIME:
 *
 *   1. REAL INFERENCE  — used when all three of these headers are available:
 *        - calib_model.h                          (generated model bytes)
 *        - calib_scaler.h                         (generated normalisation)
 *        - tensorflow/lite/micro/...              (the TFLite Micro library)
 *
 *   2. PASSTHROUGH      — used otherwise. calibrate_pm25() returns the raw
 *        value unchanged so the firmware still builds and runs before the
 *        model has been trained/exported, or before TFLite Micro is added
 *        to platformio.ini.
 *
 * The __has_include() check below is a standard C++17 preprocessor feature
 * that asks "does this header exist on the include path?" without erroring
 * if it does not.
 */

#include "ml/calibrate.h"

#include <Arduino.h>

#if defined(__has_include)
#  if __has_include("calib_model.h") && \
      __has_include("calib_scaler.h") && \
      __has_include("tensorflow/lite/micro/micro_interpreter.h")
#    define CALIB_TFLITE_ENABLED 1
#  endif
#endif


// ===========================================================================
// HALF 2: PASSTHROUGH  (model and/or TFLite Micro not available)
// ===========================================================================
#ifndef CALIB_TFLITE_ENABLED

#warning "calibrate.cpp: TFLite model not found — building in PASSTHROUGH mode. \
Run tools/pytorch_calibration/main.py to generate include/calib_model.h + \
include/calib_scaler.h, and add the TFLite Micro library to platformio.ini."

bool   calibrate_init()              { return false; }
float  calibrate_pm25(const Reading& r) { return r.pm2_5; }
bool   calibrate_model_loaded()      { return false; }
size_t calibrate_arena_used_bytes()  { return 0; }


// ===========================================================================
// HALF 1: REAL INFERENCE
// ===========================================================================
#else

#include <cmath>

// Generated by tools/pytorch_calibration/src/export.py:
#include "calib_model.h"   // g_calib_model_tflite[], g_calib_model_tflite_len
#include "calib_scaler.h"  // CALIB_MIN[], CALIB_MAX[], CALIB_N_FEATURES

// TensorFlow Lite Micro runtime headers. The exact include paths can differ
// slightly between TFLite Micro library distributions — if the compiler
// cannot find these, see the ChatGPT prompt in platformio.ini.
#include "tensorflow/lite/micro/micro_interpreter.h"
#include "tensorflow/lite/micro/micro_mutable_op_resolver.h"
#include "tensorflow/lite/schema/schema_generated.h"

// This firmware supports the two calibration models the Python pipeline can
// produce. The number of inputs is read from the generated calib_scaler.h, and
// calibrate_reading_feature() below maps each input index to a Reading field:
//   - 3 features: the combined/transfer-learned model — [pm2_5, temp, rh]
//                 (tools/pytorch_calibration: train_public.py / finetune.py)
//   - 8 features: the local SEN55+BAM model — [pm1, pm2_5, pm4, pm10,
//                 temp, rh, voc, nox]  (tools/pytorch_calibration: main.py)
// If you retrain with a different input count, update the function below.
static_assert(CALIB_N_FEATURES == 3 || CALIB_N_FEATURES == 8,
              "calibrate.cpp supports the 3-feature or 8-feature calibration "
              "model. Regenerate calib_scaler.h or update "
              "calibrate_reading_feature() for the new feature count.");

namespace {

// --- Tensor arena -----------------------------------------------------------
// TFLite Micro never calls malloc(). Instead it carves all of its working
// memory (input/output tensors + intermediate activations) out of this one
// fixed buffer. It must be large enough for the model or AllocateTensors()
// fails. 16 KB is generous for this tiny CNN; calibrate_arena_used_bytes()
// reports the true requirement so this can be trimmed later.
// alignas(16) — TFLite Micro requires the arena to be 16-byte aligned.
constexpr int kTensorArenaSize = 16 * 1024;
alignas(16) uint8_t g_tensor_arena[kTensorArenaSize];

// --- Runtime objects --------------------------------------------------------
const tflite::Model*      g_model       = nullptr;
tflite::MicroInterpreter* g_interpreter = nullptr;
TfLiteTensor*             g_input       = nullptr;
TfLiteTensor*             g_output      = nullptr;
bool                      g_loaded      = false;

/*
 * Maps a model input index to the matching field of a Reading.
 *
 * The order here MUST exactly match CALIB_FEATURE_ORDER documented in the
 * generated calib_scaler.h, which in turn matches the feature order used by
 * the Python training pipeline. A mismatch produces silently wrong
 * predictions, not a crash — so the two layouts are kept side by side and
 * selected by the model's input count.
 */
float calibrate_reading_feature(const Reading& r, int idx) {
#if CALIB_N_FEATURES == 3
    // 3-feature combined / transfer-learned model: [pm2_5, temp, rh].
    // (train_public.py / finetune.py — the AQS schema pm2_5_optical→pm2_5.)
    switch (idx) {
        case 0: return r.pm2_5;
        case 1: return r.temp_c;
        case 2: return r.rh;
        default: return 0.0f;
    }
#else
    // 8-feature local SEN55+BAM model:
    //   [0] pm1   [1] pm2_5  [2] pm4  [3] pm10
    //   [4] temp  [5] rh     [6] voc  [7] nox
    switch (idx) {
        case 0: return r.pm1;
        case 1: return r.pm2_5;
        case 2: return r.pm4;
        case 3: return r.pm10;
        case 4: return r.temp_c;
        case 5: return r.rh;
        case 6: return r.voc_index;
        case 7: return r.nox_index;
        default: return 0.0f;
    }
#endif
}

}  // namespace


bool calibrate_init() {
    // --- Wrap the raw model bytes in a TFLite Model object ------------------
    g_model = tflite::GetModel(g_calib_model_tflite);

    // The model file format has a version number. If the model was exported
    // with a newer TFLite schema than this runtime understands, bail out.
    if (g_model->version() != TFLITE_SCHEMA_VERSION) {
        Serial.print("ERROR: calib model schema ");
        Serial.print(g_model->version());
        Serial.print(" != runtime ");
        Serial.println(TFLITE_SCHEMA_VERSION);
        return false;
    }

    // --- Register the operators the model uses ------------------------------
    // TFLite Micro does not ship every possible neural-network operator — to
    // keep the firmware small you list only the ones your model needs. The
    // template number <14> is the MAXIMUM op count; add no more than that.
    //
    // The set below covers the SensaCalibNet CNN (Conv1D + global average
    // pool + two fully-connected layers) after onnx2tf conversion and int8
    // quantisation. If AllocateTensors() below fails with a message like
    //   "Didn't find op for builtin opcode '<NAME>'"
    // then add the matching resolver.Add<Name>() line here. You can list a
    // model's exact ops by opening the .tflite file in Netron (netron.app).
    static tflite::MicroMutableOpResolver<14> resolver;
    resolver.AddConv2D();          // 1-D convs are exported as 2-D convs
    resolver.AddFullyConnected();  // the two Linear regression-head layers
    resolver.AddRelu();            // activation function
    resolver.AddMean();            // global average pool -> reduce-mean
    resolver.AddAveragePool2D();   // alternative pooling representation
    resolver.AddReshape();
    resolver.AddTranspose();       // onnx2tf inserts NCHW<->NHWC transposes
    resolver.AddPad();             // conv "padding=1"
    resolver.AddExpandDims();
    resolver.AddSqueeze();
    resolver.AddQuantize();        // float -> int8 boundary ops
    resolver.AddDequantize();      // int8 -> float boundary ops

    // --- Build the interpreter ----------------------------------------------
    // 'static' so the object lives for the whole program. It is constructed
    // the first (and only) time calibrate_init() runs.
    static tflite::MicroInterpreter static_interpreter(
        g_model, resolver, g_tensor_arena, kTensorArenaSize);
    g_interpreter = &static_interpreter;

    // AllocateTensors() lays out every tensor inside the arena. This is where
    // an undersized arena or a missing operator is reported.
    if (g_interpreter->AllocateTensors() != kTfLiteOk) {
        Serial.println("ERROR: calib model AllocateTensors() failed "
                        "(arena too small or unsupported op).");
        return false;
    }

    // Cache pointers to the model's single input and single output tensor.
    g_input  = g_interpreter->input(0);
    g_output = g_interpreter->output(0);
    g_loaded = true;

    Serial.print("Calibration model loaded. Tensor arena used: ");
    Serial.print((unsigned)g_interpreter->arena_used_bytes());
    Serial.print(" / ");
    Serial.print(kTensorArenaSize);
    Serial.println(" bytes.");
    return true;
}


float calibrate_pm25(const Reading& r) {
    // No model -> passthrough.
    if (!g_loaded) return r.pm2_5;

    // --- Step 1: normalise + quantise each input feature --------------------
    // Training scaled every input to [0, 1] with a MinMaxScaler. We must
    // apply the exact same transform here using the generated constants:
    //     scaled = (raw - CALIB_MIN[i]) / (CALIB_MAX[i] - CALIB_MIN[i])
    for (int i = 0; i < CALIB_N_FEATURES; i++) {
        float raw  = calibrate_reading_feature(r, i);
        float span = CALIB_MAX[i] - CALIB_MIN[i];
        float scaled = (span > 0.0f) ? (raw - CALIB_MIN[i]) / span : 0.0f;

        // Clamp to [0, 1]. A live reading can fall outside the range the
        // model was trained on; clamping keeps the input in-distribution.
        if (scaled < 0.0f) scaled = 0.0f;
        if (scaled > 1.0f) scaled = 1.0f;

        if (g_input->type == kTfLiteInt8) {
            // The int8 model stores values as 8-bit integers. Convert using
            // the per-tensor scale + zero-point the converter chose:
            //     q = round(scaled / scale) + zero_point
            float scale = g_input->params.scale;
            int32_t q = (scale > 0.0f)
                ? (int32_t)lroundf(scaled / scale) + g_input->params.zero_point
                : g_input->params.zero_point;
            if (q < -128) q = -128;  // saturate into int8 range
            if (q >  127) q =  127;
            g_input->data.int8[i] = (int8_t)q;
        } else {
            // Float fallback (model exported without int8 quantisation).
            g_input->data.f[i] = scaled;
        }
    }

    // --- Step 2: run the network --------------------------------------------
    if (g_interpreter->Invoke() != kTfLiteOk) {
        return r.pm2_5;  // inference failed — fall back to the raw value
    }

    // --- Step 3: read + de-quantise the output ------------------------------
    // The model outputs a single number: the corrected PM2.5 in µg/m³.
    float pm25;
    if (g_output->type == kTfLiteInt8) {
        // Reverse the int8 encoding: value = (q - zero_point) * scale
        pm25 = (g_output->data.int8[0] - g_output->params.zero_point) *
               g_output->params.scale;
    } else {
        pm25 = g_output->data.f[0];
    }

    // PM2.5 is a concentration — it can never be negative.
    if (pm25 < 0.0f) pm25 = 0.0f;
    return pm25;
}


bool calibrate_model_loaded() {
    return g_loaded;
}

size_t calibrate_arena_used_bytes() {
    return g_loaded ? g_interpreter->arena_used_bytes() : 0;
}

#endif  // CALIB_TFLITE_ENABLED
